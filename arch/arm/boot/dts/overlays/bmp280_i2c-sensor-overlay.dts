// Definitions for BMP280 digital barometric pressure and temperature sensors from Bosch Sensortec
/dts-v1/;
/plugin/;

/ {
        compatible = "brcm,bcm2708";

        fragment@0 {
                target = <&i2c_arm>;
                __overlay__ {
                        #address-cells = <1>;
                        #size-cells = <0>;
                        status = "okay";

                        bmp280@77 {
                                compatible = "bosch,bmp280";
                                reg = <0x77>;
                                default-oversampling = <3>;
                                status = "okay";
                        };
                };
        };
};
